## gdp-src-build/conf/bblayers.conf
```bitbake
# LAYER_CONF_VERSION is increased each time build/conf/bblayers.conf
# changes incompatibly
LCONF_VERSION = "6"

BBPATH = "${TOPDIR}"
BBFILES ?= ""

BBLAYERS ?= " \
  ${TOPDIR}/../poky/meta \
  ${TOPDIR}/../poky/meta-yocto \
  ${TOPDIR}/../poky/meta-yocto-bsp \
  ${TOPDIR}/../meta-openembedded/meta-oe \
  ${TOPDIR}/../meta-udoo \
  ${TOPDIR}/../meta-fsl-arm \
  ${TOPDIR}/../meta-fsl-arm-extra \
  ${TOPDIR}/../meta-fsl-demos \
  "

#  ${TOPDIR}/../meta-openembedded/meta-ruby \
# ${TOPDIR}/../meta-genivi-demo
# ${TOPDIR}/../meta-qt5
#  ${TOPDIR}/../meta-ivi/meta-ivi \
#  ${TOPDIR}/../meta-ivi/meta-ivi-bsp \

BBLAYERS_NON_REMOVABLE ?= " \
  ${OEROOT}/meta \
  ${OEROOT}/meta-yocto \
  "

#  ${OEROOT}/../meta-ivi/meta-ivi \
```
